## buildroot_external/configs/chip_defconfig
```kconfig
BR2_arm=y
BR2_cortex_a8=y
BR2_ARM_INSTRUCTIONS_THUMB2=y
BR2_PACKAGE_OVERRIDE_FILE="$(BR2_EXTERNAL)/local.mk"
BR2_TOOLCHAIN_EXTERNAL=y
BR2_TOOLCHAIN_EXTERNAL_LINARO_ARM=y
BR2_TARGET_GENERIC_HOSTNAME="deepfryer"
BR2_TARGET_GENERIC_ISSUE="Welcome to C.H.I.P"
BR2_ROOTFS_POST_IMAGE_SCRIPT="$(BR2_EXTERNAL)/board/nextthing/chip/post-image.sh"
BR2_LINUX_KERNEL=y
BR2_LINUX_KERNEL_CUSTOM_GIT=y
BR2_LINUX_KERNEL_CUSTOM_REPO_URL="https://github.com/kaplan2539/ntc-linux"
BR2_LINUX_KERNEL_CUSTOM_REPO_VERSION="ntc-stable-mlc-4.4.139"
BR2_LINUX_KERNEL_USE_CUSTOM_CONFIG=y
BR2_LINUX_KERNEL_CUSTOM_CONFIG_FILE="${BR2_EXTERNAL}/board/nextthing/chip/linux.config"
BR2_LINUX_KERNEL_LZO=y
BR2_LINUX_KERNEL_DTS_SUPPORT=y
BR2_LINUX_KERNEL_INTREE_DTS_NAME="sun5i-r8-chip"
BR2_PACKAGE_DROPBEAR=y
BR2_TARGET_ROOTFS_CPIO=y
BR2_TARGET_ROOTFS_CPIO_UIMAGE=y
# BR2_TARGET_ROOTFS_TAR is not set
BR2_TARGET_UBOOT=y
BR2_TARGET_UBOOT_BUILD_SYSTEM_KCONFIG=y
BR2_TARGET_UBOOT_CUSTOM_GIT=y
BR2_TARGET_UBOOT_CUSTOM_REPO_URL="http://github.com/kaplan2539/CHIP-u-boot"
BR2_TARGET_UBOOT_CUSTOM_REPO_VERSION="a484a8471bdbc6b98c8dd342384774edf9e4e007"
BR2_TARGET_UBOOT_PATCH="$(BR2_EXTERNAL)/board/nextthing/chip/patches/CHIP-uboot"
BR2_TARGET_UBOOT_BOARD_DEFCONFIG="CHIP"
BR2_TARGET_UBOOT_NEEDS_DTC=y
# BR2_TARGET_UBOOT_FORMAT_BIN is not set
BR2_TARGET_UBOOT_FORMAT_DTB_BIN=y
BR2_TARGET_UBOOT_FORMAT_CUSTOM=y
BR2_TARGET_UBOOT_FORMAT_CUSTOM_NAME="u-boot-sunxi-with-spl.bin spl/sunxi-spl.bin"
BR2_PACKAGE_HOST_DOSFSTOOLS=y
BR2_PACKAGE_HOST_E2FSPROGS=y
BR2_PACKAGE_HOST_GENIMAGE=y
BR2_PACKAGE_HOST_MTOOLS=y
BR2_PACKAGE_CHIP_MTD_UTILS=y
BR2_PACKAGE_CHIP_MTD_UTILS_MKFSUBIFS=y
BR2_PACKAGE_GADGET_INIT_SCRIPTS=y
BR2_PACKAGE_GADGET_INIT_SCRIPTS_USB_GADGET=y
BR2_PACKAGE_CDB=y
BR2_PACKAGE_HOST_CHIP_NAND_SCRIPTS=y
BR2_PACKAGE_HOST_SUNXI_TOOLS_NG=y
```

## buildroot_external/package/chip-nand-scripts/Config.in.host
```kconfig
config BR2_PACKAGE_HOST_CHIP_NAND_SCRIPTS
	bool "CHIP-nand-scripts"
	select BR2_PACKAGE_HOST_CHIP_MTD_UTILS
	select BR2_PACKAGE_HOST_UBOOT_TOOLS
	select BR2_PACKAGE_HOST_ANDROID_TOOLS
	select BR2_PACKAGE_HOST_ANDROID_TOOLS_EXT4_UTILS
	select BR2_PACKAGE_HOST_SUNXI_TOOLS
	help
		The CHIP-nand-scripts generate images that can be flashed to CHIP's NAND.
```
